## arch/arm/hotplug/Kconfig
```kconfig
config THUNDERPLUG_CONTROL
	bool "Enable plugging down/up of cores based on load per core"
	help
	  This driver hotplugs cpu cores based on per-core load

config ALUCARD_HOTPLUG
	bool "Enable alucard hotplugging feature for cpu"
	help
	  This option enables alucard hotplugging feature.
```
